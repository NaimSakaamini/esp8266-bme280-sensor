## main/Kconfig.projbuild
```kconfig
menu "Sensor Configuration"
	
config ESPNOW_CHANNEL
    int "ESPNOW channel"
    range 1 13
    default 1
    help
		ESPNOW WiFi channel.

config ESPNOW_STATION_MAC
    string "ESPNOW Station MAC address"
    default "ff:ff:ff:ff:ff:ff"
    help
		ESPNOW MAC address of weather station device.

config ESPNOW_PMK
    string "ESPNOW primary master key"
    default "pmk1234567890123"
    help
        The length of ESPNOW primary master must be 16 bytes.

config ESPNOW_LMK
    string "ESPNOW local master key"
    default "lmk1234567890123"
    help
        The length of ESPNOW local master must be 16 bytes.

config SLEEP_TIME
    int "Sleep time in second"
    default 60
    help
		Sleep time.

endmenu
```
